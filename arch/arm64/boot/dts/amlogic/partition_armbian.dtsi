// SPDX-License-Identifier: (GPL-2.0+ OR MIT)
/*
 * Copyright (c) 2023 JetHome
 * Author: Vyacheslav Bocharov <vb@jethome.ru>
 */

/ {
	partitions: partitions {
		parts = <1>;
		part-0 = <&rootfs>;
		rootfs: rootfs {
			pname = "rootfs";
			size = <0xffffffff 0xffffffff>;
			mask = <4>;
		};
	};
};
