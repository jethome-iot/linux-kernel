/dts-v1/;
/plugin/;

#include <dt-bindings/gpio/meson-s7d-gpio.h>
#include <dt-bindings/gpio/gpio.h>

/ {
	fragment@0 {
		target-path = "/";

		__overlay__ {
			onewire {
				compatible = "w1-gpio";
				gpios = <&gpio GPIOX_4 GPIO_ACTIVE_HIGH>;
				status = "okay";
			};
		};
	};
};