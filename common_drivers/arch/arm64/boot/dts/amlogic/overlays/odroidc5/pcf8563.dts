/dts-v1/;
/plugin/;

/ {
	fragment@0 {
		target = <&i2c1>;
		__overlay__ {
			status = "okay";
			#address-cells = <1>;
			#size-cells = <0>;
			clock-frequency = <100000>;		/* default 100k */

			pcf8563: rtc@51 {
				status = "okay";
				compatible = "nxp,pcf8563";
				reg = <0x51>;
				#clock-cells = <0>;
			};
		};
	};

	fragment@1 {
		target-path = "/";
		__overlay__ {
			aliases {
				rtc0 = "/soc/i2c@66400/rtc@51";
				rtc1 = "/rtc@0xfe010288";
			};
		};
	};
};