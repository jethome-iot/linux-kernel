## common_drivers/arch/arm64/configs/amlogic_upgrade.defconfig
```kconfig
# SPDX-License-Identifier: (GPL-2.0+ OR MIT)

#break GKI
CONFIG_AMLOGIC_BREAK_GKI=y

# amlogic-uart
CONFIG_AMLOGIC_SERIAL_MESON=y

# amlogic-gkitool
CONFIG_AMLOGIC_GKI_TOOL=y

# amlogic-debug
CONFIG_AMLOGIC_DEBUG=y

# amlogic-debug-iotrace
CONFIG_AMLOGIC_DEBUG_IOTRACE=y

# amlogic-memory-debug
CONFIG_AMLOGIC_MEMORY_DEBUG=y
CONFIG_AMLOGIC_PAGE_TRACE=y
CONFIG_AMLOGIC_MEMORY_OPT=y
CONFIG_AMLOGIC_PIN_LOCKED_FILE=y

# amlogic-secmon
CONFIG_AMLOGIC_SECMON=y

# amlogic-clk
CONFIG_AMLOGIC_COMMON_CLK=y

# amlogic-clk-soc-xxx
CONFIG_AMLOGIC_COMMON_CLK_C2=y
CONFIG_AMLOGIC_COMMON_CLK_C3=y
CONFIG_AMLOGIC_COMMON_CLK_A1=y
CONFIG_AMLOGIC_COMMON_CLK_S4=y
CONFIG_AMLOGIC_COMMON_CLK_SC2=y
CONFIG_AMLOGIC_COMMON_CLK_T3=y
CONFIG_AMLOGIC_COMMON_CLK_T7=y
CONFIG_AMLOGIC_COMMON_CLK_T5M=y
CONFIG_AMLOGIC_COMMON_CLK_G12A=y
CONFIG_AMLOGIC_COMMON_CLK_S5=y
CONFIG_AMLOGIC_COMMON_CLK_T5W=y
CONFIG_AMLOGIC_COMMON_CLK_T3X=y
CONFIG_AMLOGIC_COMMON_CLK_TM2=y
CONFIG_AMLOGIC_COMMON_AO_CLK_TM2=y

# amlogic-gpio
CONFIG_AMLOGIC_GPIO=y

# amlogic-pinctrl-soc-xxx
CONFIG_AMLOGIC_PINCTRL_MESON_C2=y
CONFIG_AMLOGIC_PINCTRL_MESON_C3=y
CONFIG_AMLOGIC_PINCTRL_MESON_A1=y
CONFIG_AMLOGIC_PINCTRL_MESON_TXHD2=y
CONFIG_AMLOGIC_PINCTRL_MESON_S4=y
CONFIG_AMLOGIC_PINCTRL_MESON_SC2=y
CONFIG_AMLOGIC_PINCTRL_MESON_T3=y
CONFIG_AMLOGIC_PINCTRL_MESON_T7=y
CONFIG_AMLOGIC_PINCTRL_MESON_T5M=y
CONFIG_AMLOGIC_PINCTRL_MESON_G12A=y
CONFIG_AMLOGIC_PINCTRL_MESON_S5=y
CONFIG_AMLOGIC_PINCTRL_MESON_T5W=y
CONFIG_AMLOGIC_PINCTRL_MESON_T3X=y
CONFIG_AMLOGIC_PINCTRL_MESON_TM2=y

# amlogic-mailbox
CONFIG_AMLOGIC_MHU_MBOX=y

# amlogic-pwm
CONFIG_AMLOGIC_PWM=y
CONFIG_AMLOGIC_PWM_MESON=y
CONFIG_AMLOGIC_PWM_MESON_TEE=y

# pwm-regulator
CONFIG_REGULATOR_PWM=y
CONFIG_AMLOGIC_PWM_REGULATOR=y

# amlogic-power
CONFIG_AMLOGIC_POWER=y

# amlogic-cpuinfo
CONFIG_AMLOGIC_CPU_INFO=y

# amlogic-cpufreq
CONFIG_AMLOGIC_MESON_CPUFREQ=y

# amlogic-reset
CONFIG_AMLOGIC_RESET_MESON=y
CONFIG_AMLOGIC_DOS_RESET_MESON=y

# amlogic-efuse-unifykey
CONFIG_AMLOGIC_EFUSE_UNIFYKEY=y

# amlogic-mmc
CONFIG_AMLOGIC_MMC_MESON_GX=y
CONFIG_MMC_CQHCI=y

# system_heap
CONFIG_DMABUF_HEAPS_SYSTEM=y

# amlogic-i2c
CONFIG_AMLOGIC_I2C_MESON=y

# amlogic-spi
CONFIG_AMLOGIC_SPI=y

# amlogic-rng
CONFIG_AMLOGIC_HW_RANDOM_MESON=y

# amlogic-tee
CONFIG_AMLOGIC_TEE=y

CONFIG_AMLOGIC_AMLTEE=y
CONFIG_AMLOGIC_OPTEE=y
CONFIG_AMLOGIC_WATERMARK=n

# videobuf-core
CONFIG_AMLOGIC_MEDIA_UTILS=y

# dvb-core
CONFIG_DVB_CORE=y

# amlogic-pm
CONFIG_AMLOGIC_PM=y

# amlogic-input
CONFIG_AMLOGIC_INPUT=y

# amlogic-watchdog
CONFIG_AMLOGIC_MESON_GXBB_WATCHDOG=y

# amlogic-dvb
CONFIG_AMLOGIC_DVB_CONFIG=y

# amlogic-dvb-ci
# CONFIG_AMLOGIC_DVB_CI=y

# aml_media
CONFIG_AMLOGIC_MEDIA_MODULE=y
CONFIG_FB=y
CONFIG_AMLOGIC_MEDIA_FB=y
CONFIG_AMLOGIC_MEDIA_FB_OSD_SYNC_FENCE=y
CONFIG_AMLOGIC_MEDIA_FB_OSD_VSYNC_RDMA=y
CONFIG_AMLOGIC_MEDIA_FB_OSD2_ENABLE=y
CONFIG_AMLOGIC_MEDIA_FB_OSD2_CURSOR=y
CONFIG_AMLOGIC_MEDIA_V4L2=y

# vts
CONFIG_AMLOGIC_BGKI_SCHED_SYSCTL=y

# boot optimize
CONFIG_AMLOGIC_BOOT_TIME=y

# remove rc core
# CONFIG_RC_CORE is not set

# remove other platform feature
CONFIG_ARCH_QCOM=n
CONFIG_GPIOLIB=y
CONFIG_QCOM_SMEM_STATE=n
CONFIG_ARCH_HISI=n
CONFIG_ARCH_SUNXI=n
CONFIG_PINCTRL=y
CONFIG_SERIAL_SAMSUNG=n
CONFIG_SERIAL_SPRD=n
CONFIG_SERIAL_SPRD_CONSOLE=n

# disable android vendor data
CONFIG_ANDROID_VENDOR_OEM_DATA=n
CONFIG_ANDROID_KABI_RESERVE=n

# remove unuse file system
CONFIG_VIRTIO_FS=n

# remove shadow call stack
CONFIG_SHADOW_CALL_STACK=n

# Kernel-based Virtual Machine
CONFIG_VIRTUALIZATION=n
CONFIG_KVM=n

# remove framebuffer
CONFIG_FB=n

# ARMv8.3 architectural features
CONFIG_ARM64_PTR_AUTH=n
CONFIG_ARM64_PTR_AUTH_KERNEL=n
CONFIG_CC_HAS_BRANCH_PROT_PAC_RET=n
CONFIG_CC_HAS_SIGN_RETURN_ADDRESS=n
CONFIG_AS_HAS_PAC=n
CONFIG_AS_HAS_CFI_NEGATE_RA_STATE=n

# ARMv8.4 architectural features
CONFIG_ARM64_AMU_EXTN=n
CONFIG_AS_HAS_ARMV8_4=n
CONFIG_ARM64_TLB_RANGE=n
CONFIG_ARM64_MPAM=n

# ARMv8.5 architectural features
CONFIG_AS_HAS_ARMV8_5=n
CONFIG_ARM64_BTI=n
# CONFIG_ARM64_BTI_KERNEL is not set
CONFIG_CC_HAS_BRANCH_PROT_PAC_RET_BTI=n
CONFIG_ARM64_E0PD=n
CONFIG_ARCH_RANDOM=n

# ARMv8.7 architectural features
CONFIG_ARM64_EPAN=n

# remove kasan
CONFIG_KASAN=n
CONFIG_UBSAN=n

# remove other unuse feature
# CONFIG_WLAN_VENDOR_MICROCHIP is not set
# CONFIG_NET_VENDOR_ALACRITECH is not set
# CONFIG_NET_VENDOR_ALLWINNER is not set
# CONFIG_NET_VENDOR_AQUANTIA is not set
# CONFIG_NET_VENDOR_CADENCE is not set
# CONFIG_NET_VENDOR_CORTINA is not set
# CONFIG_NET_VENDOR_GOOGLE is not set
# CONFIG_NET_VENDOR_HUAWEI is not set
# CONFIG_NET_VENDOR_LITEX is not set
# CONFIG_NET_VENDOR_MICROSEMI is not set
# CONFIG_NET_VENDOR_MICROSOFT is not set
# CONFIG_NET_VENDOR_NI is not set
# CONFIG_NET_VENDOR_NETERION is not set
# CONFIG_NET_VENDOR_PACKET_ENGINES is not set
# CONFIG_NET_VENDOR_PENSANDO is not set
# CONFIG_NET_VENDOR_SOLARFLARE is not set
# CONFIG_NET_VENDOR_SOCIONEXT is not set
# CONFIG_NET_VENDOR_XILINX is not set
# CONFIG_NET_VENDOR_VIA is not set
# CONFIG_NET_VENDOR_SYNOPSYS is not set
# CONFIG_NET_VENDOR_AMAZON is not set
# CONFIG_NET_VENDOR_AMD is not set
# CONFIG_NET_VENDOR_ARC is not set
# CONFIG_NET_VENDOR_CAVIUM is not set
# CONFIG_NET_VENDOR_BROADCOM is not set
# CONFIG_NET_VENDOR_HISILICON is not set
# CONFIG_NET_VENDOR_I825XX is not set
# CONFIG_NET_VENDOR_MARVELL is not set
# CONFIG_NET_VENDOR_INTEL is not set
# CONFIG_NET_VENDOR_MELLANOX is not set
# CONFIG_NET_VENDOR_MICROCHIP is not set
# CONFIG_NET_VENDOR_NATSEMI is not set
# CONFIG_NET_VENDOR_NETRONOME is not set
# CONFIG_NET_VENDOR_8390 is not set
# CONFIG_NET_VENDOR_QUALCOMM is not set
# CONFIG_NET_VENDOR_RENESAS is not set
# CONFIG_NET_VENDOR_ROCKER is not set
# CONFIG_NET_VENDOR_SAMSUNG is not set
# CONFIG_NET_VENDOR_SMSC is not set
# CONFIG_NET_VENDOR_WIZNET is not set
# CONFIG_NET_VENDOR_EZCHIP is not set
# CONFIG_NET_VENDOR_MICREL is not set
# CONFIG_NET_VENDOR_SEEQ is not set
# CONFIG_NET_VENDOR_SILAN is not set
# CONFIG_NET_VENDOR_REALTEK is not set
# CONFIG_NET_VENDOR_3COM is not set
# CONFIG_NET_VENDOR_ADAPTEC is not set
# CONFIG_NET_VENDOR_AGERE is not set
# CONFIG_NET_VENDOR_ALTEON is not set
# CONFIG_NET_VENDOR_ATHEROS is not set
# CONFIG_NET_VENDOR_CHELSIO is not set
# CONFIG_NET_VENDOR_CISCO is not set
# CONFIG_NET_VENDOR_DEC is not set
# CONFIG_NET_VENDOR_DLINK is not set
# CONFIG_NET_VENDOR_EMULEX is not set
# CONFIG_NET_VENDOR_MYRI is not set
# CONFIG_NET_VENDOR_NVIDIA is not set
# CONFIG_NET_VENDOR_OKI is not set
# CONFIG_NET_VENDOR_QLOGIC is not set
# CONFIG_NET_VENDOR_BROCADE is not set
# CONFIG_NET_VENDOR_RDC is not set
# CONFIG_NET_VENDOR_REALTEK is not set
# CONFIG_NET_VENDOR_SILAN is not set
# CONFIG_NET_VENDOR_SUN is not set
# CONFIG_NET_VENDOR_TEHUTI is not set
# CONFIG_NET_VENDOR_TI is not set

# remove other soc bug fix
CONFIG_QCOM_FALKOR_ERRATUM_1003=n
CONFIG_QCOM_FALKOR_ERRATUM_1009=n
CONFIG_QCOM_QDF2400_ERRATUM_0065=n
CONFIG_QCOM_FALKOR_ERRATUM_E1041=n
CONFIG_HISILICON_ERRATUM_161600802=n
CONFIG_FUJITSU_ERRATUM_010001=n
CONFIG_CAVIUM_TX2_ERRATUM_219=n
CONFIG_CAVIUM_ERRATUM_30115=n
CONFIG_CAVIUM_ERRATUM_27456=n
CONFIG_CAVIUM_ERRATUM_23154=n
CONFIG_CAVIUM_ERRATUM_22375=n
CONFIG_NVIDIA_CARMEL_CNP_ERRATUM=n
CONFIG_SOCIONEXT_SYNQUACER_PREITS=n

# Qualcomm SoC drivers
CONFIG_QCOM_SMEM_STATE=n

# HID feature from y to m
CONFIG_HID_APPLE=m
CONFIG_HID_PRODIKEYS=m
CONFIG_HID_ELECOM=m
CONFIG_HID_UCLOGIC=m
CONFIG_HID_LOGITECH=m
CONFIG_HID_MAGICMOUSE=m
CONFIG_HID_MICROSOFT=m
CONFIG_HID_MULTITOUCH=m
CONFIG_HID_NINTENDO=m
CONFIG_HID_PICOLCD=m
CONFIG_HID_PLANTRONICS=m
CONFIG_HID_ROCCAT=m
CONFIG_HID_STEAM=m
CONFIG_HID_WIIMOTE=m

# make NFC from y to m
CONFIG_NFC=m

#remove i3c feature
CONFIG_I3C=n

# remove memory hotplug feature
CONFIG_MEMORY_HOTPLUG=n

# remove unused mfd feature
CONFIG_MFD_ACT8945A=n

# remove unused rtc
CONFIG_RTC_DRV_PL030=n
CONFIG_RTC_DRV_PL031=n

# remove unused PS/2 plug
CONFIG_SERIO=n
CONFIG_SERIO_LIBPS2=n

# remove unused compress feature
CONFIG_RD_BZIP2=n
CONFIG_RD_XZ=n
CONFIG_RD_LZO=n

#remove debug info
CONFIG_DEBUG_INFO_BTF=n
```

## common_drivers/drivers/amfc/Kconfig
```kconfig
config AMLOGIC_AMFC
	tristate "Amlogic AMFC driver"
	default n
	help
		Amlogic AMFC driver for
		Hardware compress/decompress module
		This module can help for speed up
		zram and some other cases which using compress/decompress

choice
	prompt "AMFC soc"
	depends on AMLOGIC_AMFC
	default AMFC_S7D
	help
		select which soc for AMFC related drivers

config AMFC_S7D
	bool "AMFC on S7D"

config AMFC_T6D
	bool "AMFC on T6D"

endchoice

config AMFC_BASE
	hex "io base for decompress kernel"
	default 0xfe024000 if AMFC_S7D
	default 0xfe092000 if AMFC_T6D
	default 0xfe024000
	help
		Register base of AMFC for decompress uImage code.

source "$(COMMON_DRIVERS_DIR)/drivers/amfc/aml_erofs/Kconfig"
```

## common_drivers/drivers/amfc/aml_erofs/Kconfig
```kconfig
# SPDX-License-Identifier: GPL-2.0-only

config AMLOGIC_EROFS
	tristate "AMLOGIC EROFS filesystem support"
	depends on BLOCK
	select FS_IOMAP
	select LIBCRC32C
	help
	  Amlogic EROFS is amlogic self modified EROFS to get decompression
	  support by AMFC hardware to accelerate decompression speed. Most
	  content of this driver is copy from EROFS

	  If unsure, say N.

config AMLOGIC_EROFS_DEBUG
	bool "AMLOGIC EROFS debugging feature"
	depends on AMLOGIC_EROFS
	help
	  Print debugging messages and enable more BUG_ONs which check
	  filesystem consistency and find potential issues aggressively,
	  which can be used for Android eng build, for example.

	  For daily use, say N.

config AMLOGIC_EROFS_XATTR
	bool "AMLOGIC EROFS extended attributes"
	depends on AMLOGIC_EROFS
	default y
	help
	  Extended attributes are name:value pairs associated with inodes by
	  the kernel or by users (see the attr(5) manual page, or visit
	  <http://acl.bestbits.at/> for details).

	  If unsure, say N.

config AMLOGIC_EROFS_POSIX_ACL
	bool "AMLOGIC EROFS Access Control Lists"
	depends on AMLOGIC_EROFS_XATTR
	select FS_POSIX_ACL
	default y
	help
	  Posix Access Control Lists (ACLs) support permissions for users and
	  groups beyond the owner/group/world scheme.

	  To learn more about Access Control Lists, visit the POSIX ACLs for
	  Linux website <http://acl.bestbits.at/>.

	  If you don't know what Access Control Lists are, say N.

config AMLOGIC_EROFS_SECURITY
	bool "AMLOGIC EROFS Security Labels"
	depends on AMLOGIC_EROFS_XATTR
	default y
	help
	  Security labels provide an access control facility to support Linux
	  Security Models (LSMs) accepted by AppArmor, SELinux, Smack and TOMOYO
	  Linux. This option enables an extended attribute handler for file
	  security labels in the erofs filesystem, so that it requires enabling
	  the extended attribute support in advance.

	  If you are not using a security module, say N.

config AMLOGIC_EROFS_ZIP
	bool "AMLOGIC EROFS Data Compression Support"
	depends on AMLOGIC_EROFS
	select LZ4_DECOMPRESS
	default y
	help
	  Enable fixed-sized output compression for AMLOGIC EROFS.

	  If you don't want to enable compression feature, say N.

config AMLOGIC_EROFS_ZIP_LZMA
	bool "AMLOGIC EROFS LZMA compressed data support"
	depends on AMLOGIC_EROFS_ZIP
	select XZ_DEC
	select XZ_DEC_MICROLZMA
	help
	  Saying Y here includes support for reading AMLOGIC EROFS file systems
	  containing LZMA compressed data, specifically called microLZMA. it
	  gives better compression ratios than the LZ4 algorithm, at the
	  expense of more CPU overhead.

	  LZMA support is an experimental feature for now and so most file
	  systems will be readable without selecting this option.

	  If unsure, say N.

config AMLOGIC_EROFS_PCPU_KTHREAD
	bool "AMLOGIC EROFS per-cpu decompression kthread workers"
	depends on AMLOGIC_EROFS_ZIP
	help
	  Saying Y here enables per-CPU kthread workers pool to carry out
	  async decompression for low latencies on some architectures.

	  If unsure, say N.

config AMLOGIC_EROFS_PCPU_KTHREAD_HIPRI
	bool "AMLOGIC EROFS high priority per-CPU kthread workers"
	depends on AMLOGIC_EROFS_ZIP && AMLOGIC_EROFS_PCPU_KTHREAD
	help
	  This permits AMLOGIC EROFS to configure per-CPU kthread workers to run
	  at higher priority.

	  If unsure, say N.

config AMLOGIC_EROFS_CRYPTO_MAX_PAGES
	int "AMLOGIC EROFS max distance pages for crypto usage"
	default 32
	help
	  This config defines max distance pages for crypto. Crypto layer
	  will use this value to grow up PCP buffers.
	  Default value is 128KB(32 pages).
	  You can change it to your value.
```

## common_drivers/drivers/hid/Kconfig
```kconfig
# SPDX-License-Identifier: (GPL-2.0+ OR MIT)
#
# Amlogic hid driver configuration
#

config AMLOGIC_ADD_RUMBLE
	tristate "Add rumble support to latest xbox controllers"
	depends on AMLOGIC_BREAK_GKI
	default n
	help
	  Say 'Y' here if you want to support rumble.
```

## common_drivers/drivers/media/vout/DisplayPort/Kconfig
```kconfig
# SPDX-License-Identifier: (GPL-2.0+ OR MIT)

#
# Video output configuration
#
menu "Amlogic DisplayPort Output Module"

config AMLOGIC_DisplayPort_TX
	bool "DisplayPort Output Module"
	default n
	help
		Support for DisplayPort/eDP output

endmenu
```

## common_drivers/drivers/mtd/spinor/Kconfig
```kconfig
# SPDX-License-Identifier: (GPL-2.0+ OR MIT)

config AMLOGIC_MTD_SPI_NOR
        tristate "AMLOGIC SPI NOR support"
        default n
        depends on MTD && SPI_MASTER
        depends on AMLOGIC_BREAK_GKI
        select SPI_MEM
        help
          This is based on MTD_SPI_NOR, adding partition management.
          Say Y, Will register partitions according to bootargs or dts management.
          Say N, Only register one mtd device.
```

## common_drivers/drivers/regulator/Kconfig
```kconfig
# SPDX-License-Identifier: (GPL-2.0+ OR MIT)

if REGULATOR

config AMLOGIC_REGULATOR
	tristate "Amlogic regulator devices support"
	default n
	help
	  regulator devices support
	  select y for built-in
	  select m for ko
	  select n for disable

if AMLOGIC_REGULATOR
source "$(COMMON_DRIVERS_DIR)/drivers/regulator/meson_pmic6b/Kconfig"
endif

config AMLOGIC_PWM_REGULATOR
	bool "PWM voltage regulator for AMLOGIC define"
	depends on REGULATOR_PWM
	help
	  This driver supports some feature of PWM regulators.
	  such as:
	  1. need use regulator to delay dvfs voltage setting;
	  2. deal with problem of voltage by changed to max booting to kernel;

endif
```

## common_drivers/drivers/wireless/bluetooth/Kconfig
```kconfig
# SPDX-License-Identifier: (GPL-2.0+ OR MIT)

config AMLOGIC_BLUETOOTH
	bool "BT Device support"
	depends on BT && RFKILL
	default n
	help
	  Say Y here if you want to use the BT device.

config AMLOGIC_BT_WAKE_NOT_REPORT
	bool "BT wake up not report key event"
	depends on AMLOGIC_BLUETOOTH
	default n
	help
	  Say Y here if you dont want to help reporting key event
	  when system waken up by BT
```
